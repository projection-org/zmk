/*
 * Copyright (c) 2020 The ZMK Contributors
 *
 * SPDX-License-Identifier: MIT
 */

/ {
    behaviors {
        /omit-if-no-ref/ mkp: mouse_key_press {
            compatible = "zmk,behavior-mouse-key-press";
            #binding-cells = <1>;
        };
    };

    mkp_input_listener: mkp_input_listener {
        compatible = "zmk,input-listener";
        device = <&mkp>;
    };
};
